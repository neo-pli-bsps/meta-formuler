## conf/machine/formuler1.conf
```bitbake
#@TYPE: Machine
#@NAME: formuler f1
#@DESCRIPTION: Machine configuration for the formuler f1

MKUBIFS_ARGS = "-m 2048 -e 126976 -c 8192"
UBINIZE_ARGS = "-m 2048 -p 128KiB"

MACHINE_FEATURES += "textlcd dvb-c YUV RCA"

CHIPSET = "bcm7356"

require conf/machine/include/formuler.inc

SOC_FAMILY = "bcm7356"
```
